## Software/Sourcev2/app/build/Kconfig/Kconfig.shield
```kconfig
osource "/Users/tongtong/Library/Mobile Documents/com~apple~CloudDocs/Personal/Projects/Revolute/Software/Sourcev2/boards/shields/*/Kconfig.shield"
osource "/opt/nordic/ncs/v2.4.0/nrf/boards/shields/*/Kconfig.shield"
```

## Software/Sourcev2/app/build/Kconfig/Kconfig.shield.defconfig
```kconfig
osource "/Users/tongtong/Library/Mobile Documents/com~apple~CloudDocs/Personal/Projects/Revolute/Software/Sourcev2/boards/shields/*/Kconfig.defconfig"
osource "/opt/nordic/ncs/v2.4.0/nrf/boards/shields/*/Kconfig.defconfig"
```

## Software/Sourcev2/backup/app(with serial log)/build/Kconfig/Kconfig.modules
```kconfig
menu "acpica (C:/Users/T0ngx/Documents/zephyrproject/modules/lib/acpica)"
osource "$(ZEPHYR_ACPICA_KCONFIG)"
config ZEPHYR_ACPICA_MODULE
	bool
	default y
endmenu
menu "canopennode (C:/Users/T0ngx/Documents/zephyrproject/modules/lib/canopennode)"
osource "$(ZEPHYR_CANOPENNODE_KCONFIG)"
config ZEPHYR_CANOPENNODE_MODULE
	bool
	default y
endmenu
menu "chre (C:/Users/T0ngx/Documents/zephyrproject/modules/lib/chre)"
osource "C:/Users/T0ngx/Documents/zephyrproject/modules/lib/chre/platform/zephyr/Kconfig"
config ZEPHYR_CHRE_MODULE
	bool
	default y
endmenu
menu "fatfs (C:/Users/T0ngx/Documents/zephyrproject/modules/fs/fatfs)"
osource "$(ZEPHYR_FATFS_KCONFIG)"
config ZEPHYR_FATFS_MODULE
	bool
	default y
endmenu
menu "hal_espressif (C:/Users/T0ngx/Documents/zephyrproject/modules/hal/espressif)"
osource "C:/Users/T0ngx/Documents/zephyrproject/modules/hal/espressif/zephyr/Kconfig"
config ZEPHYR_HAL_ESPRESSIF_MODULE
	bool
	default y
endmenu
menu "hal_ethos_u (C:/Users/T0ngx/Documents/zephyrproject/modules/hal/ethos_u)"
osource "$(ZEPHYR_HAL_ETHOS_U_KCONFIG)"
config ZEPHYR_HAL_ETHOS_U_MODULE
	bool
	default y
endmenu
menu "hal_gigadevice (C:/Users/T0ngx/Documents/zephyrproject/modules/hal/gigadevice)"
osource "$(ZEPHYR_HAL_GIGADEVICE_KCONFIG)"
config ZEPHYR_HAL_GIGADEVICE_MODULE
	bool
	default y
endmenu
menu "hal_infineon (C:/Users/T0ngx/Documents/zephyrproject/modules/hal/infineon)"
osource "$(ZEPHYR_HAL_INFINEON_KCONFIG)"
config ZEPHYR_HAL_INFINEON_MODULE
	bool
	default y
endmenu
menu "hal_nordic (C:/Users/T0ngx/Documents/zephyrproject/modules/hal/nordic)"
osource "$(ZEPHYR_HAL_NORDIC_KCONFIG)"
config ZEPHYR_HAL_NORDIC_MODULE
	bool
	default y
endmenu
menu "hal_nxp (C:/Users/T0ngx/Documents/zephyrproject/modules/hal/nxp)"
osource "$(ZEPHYR_HAL_NXP_KCONFIG)"
config ZEPHYR_HAL_NXP_MODULE
	bool
	default y
endmenu
menu "hal_rpi_pico (C:/Users/T0ngx/Documents/zephyrproject/modules/hal/rpi_pico)"
osource "$(ZEPHYR_HAL_RPI_PICO_KCONFIG)"
config ZEPHYR_HAL_RPI_PICO_MODULE
	bool
	default y
endmenu
menu "silabs (C:/Users/T0ngx/Documents/zephyrproject/modules/hal/silabs)"
osource "C:/Users/T0ngx/Documents/zephyrproject/modules/hal/silabs/zephyr/Kconfig"
config ZEPHYR_SILABS_MODULE
	bool
	default y
endmenu
menu "hal_telink (C:/Users/T0ngx/Documents/zephyrproject/modules/hal/telink)"
osource "C:/Users/T0ngx/Documents/zephyrproject/modules/hal/telink/Kconfig"
config ZEPHYR_HAL_TELINK_MODULE
	bool
	default y
endmenu
menu "liblc3 (C:/Users/T0ngx/Documents/zephyrproject/modules/lib/liblc3)"
osource "$(ZEPHYR_LIBLC3_KCONFIG)"
config ZEPHYR_LIBLC3_MODULE
	bool
	default y
endmenu
menu "littlefs (C:/Users/T0ngx/Documents/zephyrproject/modules/fs/littlefs)"
osource "$(ZEPHYR_LITTLEFS_KCONFIG)"
config ZEPHYR_LITTLEFS_MODULE
	bool
	default y
endmenu
menu "loramac-node (C:/Users/T0ngx/Documents/zephyrproject/modules/lib/loramac-node)"
osource "$(ZEPHYR_LORAMAC_NODE_KCONFIG)"
config ZEPHYR_LORAMAC_NODE_MODULE
	bool
	default y
endmenu
menu "lvgl (C:/Users/T0ngx/Documents/zephyrproject/modules/lib/gui/lvgl)"
osource "C:/Users/T0ngx/Documents/zephyrproject/modules/lib/gui/lvgl/zephyr/Kconfig"
config ZEPHYR_LVGL_MODULE
	bool
	default y
endmenu
menu "lz4 (C:/Users/T0ngx/Documents/zephyrproject/modules/lib/lz4)"
osource "$(ZEPHYR_LZ4_KCONFIG)"
config ZEPHYR_LZ4_MODULE
	bool
	default y
endmenu
menu "mbedtls (C:/Users/T0ngx/Documents/zephyrproject/modules/crypto/mbedtls)"
osource "$(ZEPHYR_MBEDTLS_KCONFIG)"
config ZEPHYR_MBEDTLS_MODULE
	bool
	default y
endmenu
menu "nanopb (C:/Users/T0ngx/Documents/zephyrproject/modules/lib/nanopb)"
osource "$(ZEPHYR_NANOPB_KCONFIG)"
config ZEPHYR_NANOPB_MODULE
	bool
	default y
endmenu
menu "openthread (C:/Users/T0ngx/Documents/zephyrproject/modules/lib/openthread)"
osource "$(ZEPHYR_OPENTHREAD_KCONFIG)"
config ZEPHYR_OPENTHREAD_MODULE
	bool
	default y
endmenu
menu "picolibc (C:/Users/T0ngx/Documents/zephyrproject/modules/lib/picolibc)"
osource "C:/Users/T0ngx/Documents/zephyrproject/modules/lib/picolibc/zephyr/Kconfig"
config ZEPHYR_PICOLIBC_MODULE
	bool
	default y
endmenu
menu "segger (C:/Users/T0ngx/Documents/zephyrproject/modules/debug/segger)"
osource "$(ZEPHYR_SEGGER_KCONFIG)"
config ZEPHYR_SEGGER_MODULE
	bool
	default y
endmenu
menu "sof (C:/Users/T0ngx/Documents/zephyrproject/modules/audio/sof)"
osource "C:/Users/T0ngx/Documents/zephyrproject/modules/audio/sof/zephyr/Kconfig"
config ZEPHYR_SOF_MODULE
	bool
	default y
endmenu
menu "tflite-micro (C:/Users/T0ngx/Documents/zephyrproject/modules/lib/tflite-micro)"
osource "$(ZEPHYR_TFLITE_MICRO_KCONFIG)"
config ZEPHYR_TFLITE_MICRO_MODULE
	bool
	default y
endmenu
menu "TraceRecorder (C:/Users/T0ngx/Documents/zephyrproject/modules/debug/TraceRecorder)"
osource "C:/Users/T0ngx/Documents/zephyrproject/modules/debug/TraceRecorder/kernelports/Zephyr/Kconfig"
config ZEPHYR_TRACERECORDER_MODULE
	bool
	default y
endmenu
menu "trusted-firmware-m (C:/Users/T0ngx/Documents/zephyrproject/modules/tee/tf-m/trusted-firmware-m)"
osource "$(ZEPHYR_TRUSTED_FIRMWARE_M_KCONFIG)"
config ZEPHYR_TRUSTED_FIRMWARE_M_MODULE
	bool
	default y
endmenu
menu "trusted-firmware-a (C:/Users/T0ngx/Documents/zephyrproject/modules/tee/tf-a/trusted-firmware-a)"
osource "$(ZEPHYR_TRUSTED_FIRMWARE_A_KCONFIG)"
config ZEPHYR_TRUSTED_FIRMWARE_A_MODULE
	bool
	default y
endmenu
menu "uoscore-uedhoc (C:/Users/T0ngx/Documents/zephyrproject/modules/lib/uoscore-uedhoc)"
osource "$(ZEPHYR_UOSCORE_UEDHOC_KCONFIG)"
config ZEPHYR_UOSCORE_UEDHOC_MODULE
	bool
	default y
endmenu
menu "zcbor (C:/Users/T0ngx/Documents/zephyrproject/modules/lib/zcbor)"
osource "$(ZEPHYR_ZCBOR_KCONFIG)"
config ZEPHYR_ZCBOR_MODULE
	bool
	default y
endmenu
menu "zscilib (C:/Users/T0ngx/Documents/zephyrproject/modules/lib/zscilib)"
osource "C:/Users/T0ngx/Documents/zephyrproject/modules/lib/zscilib/Kconfig.zscilib"
config ZEPHYR_ZSCILIB_MODULE
	bool
	default y
endmenu
menu "thrift (C:/Users/T0ngx/Documents/zephyrproject/modules/lib/thrift)"
osource "$(ZEPHYR_THRIFT_KCONFIG)"
config ZEPHYR_THRIFT_MODULE
	bool
	default y
endmenu
```

## Software/Sourcev2/boards/arm/divisionL/Kconfig.defconfig
```kconfig
if BOARD_DIVISIONL

config ZMK_KEYBOARD_NAME
	default "Division"

config ZMK_SPLIT
    default y
	
config ZMK_SPLIT_ROLE_CENTRAL
    default y

if USB_DEVICE_STACK

config USB_NRFX
	default y

endif # USB_DEVICE_STACK

config BT_CTLR
	default BT

config ZMK_BLE
	default y

config ZMK_USB
	default y

endif # BOARD_DIVISIONL
```

## Software/Sourcev2/boards/arm/divisionR/Kconfig.defconfig
```kconfig
if BOARD_DIVISIONR

config ZMK_KEYBOARD_NAME
	default "Division"

config ZMK_SPLIT
    default y

if USB_DEVICE_STACK

config USB_NRFX
	default y

endif # USB_DEVICE_STACK

config BT_CTLR
	default BT

config ZMK_BLE
	default y

config ZMK_USB
	default y

endif # BOARD_DIVISIONR
```

## Software/Sourcev2/boards/arm/revolute/Kconfig.board
```kconfig
# nRF52840 MDK USB Dongle board configuration

# Copyright (c) 2022 Nikola Trifunovic
# Copyright (c) 2018 Nordic Semiconductor ASA
# SPDX-License-Identifier: Apache-2.0

config BOARD_REVOLUTE
	bool "Revolute"
	depends on SOC_NRF52840_QIAA
```

## Software/Sourcev2/boards/arm/revolutewireless/Kconfig
```kconfig
# Revolute wireless
# Copyright (c) 2024 Tongtong Wang


if BOARD_REVOLUTEWIRELESS

config BOARD_ENABLE_DCDC
	bool "DCDC mode"
	select SOC_DCDC_NRF52X
	default y

config BOARD_HAS_NRF5_BOOTLOADER
	bool "Board has nRF5 bootloader"
	default y
	help
	  If selected, applications are linked so that they can be loaded by Nordic
	  nRF5 bootloader.

#config I2C
#	default y



endif # BOARD_REVOLUTE
```

## Software/Sourcev2/boards/arm/revolutewireless/Kconfig.board
```kconfig
# nRF52840 MDK USB Dongle board configuration

# Copyright (c) 2022 Nikola Trifunovic
# Copyright (c) 2018 Nordic Semiconductor ASA
# SPDX-License-Identifier: Apache-2.0

config BOARD_REVOLUTEWIRELESS
	bool "Revolutewireless"
	depends on SOC_NRF52833_QIAA
```

## Software/Sourcev2/boards/arm/revolutewireless/Kconfig.defconfig
```kconfig
if BOARD_REVOLUTEWIRELESS

config BOARD
	default "revolutewireless"

config FLASH_LOAD_OFFSET
	default 0x1000
	depends on BOARD_HAS_NRF5_BOOTLOADER && !USE_DT_CODE_PARTITION

if USB_DEVICE_STACK

# Enable UART driver, needed for CDC ACM
config SERIAL
	default y

endif # USB_DEVICE_STACK

config BT_CTLR
	default BT

endif # BOARD_REVOLUTE
```

## Software/Sourcev2/boards/arm/revolutewireless/revolutewireless_defconfig
```kconfig
# SPDX-License-Identifier: Apache-2.0


# SPDX-License-Identifier: Apache-2.0




CONFIG_SOC_SERIES_NRF52X=y
CONFIG_SOC_NRF52833_QIAA=y


CONFIG_BOARD_REVOLUTEWIRELESS=y

# Enable Logging
CONFIG_UART_CONSOLE=y
CONFIG_SERIAL=y
CONFIG_LOG=n

# Enable MPU
CONFIG_ARM_MPU=y

# Enable hardware stack protection
CONFIG_HW_STACK_PROTECTION=y
CONFIG_PINCTRL=y

# enable GPIO
CONFIG_GPIO=y
CONFIG_BUILD_OUTPUT_UF2=y

# additional board options
CONFIG_GPIO_AS_PINRESET=y
# CONFIG_NFCT_PINS_AS_GPIOS=y

#i2c
CONFIG_SENSOR=y
CONFIG_I2C=y
CONFIG_AMS_AS5600=y
# CONFIG_NRFX_TWI0=y



# USB
#CONFIG_USB=y
CONFIG_USB_DEVICE_STACK=y
CONFIG_USB_CDC_ACM=y
CONFIG_USB_DEVICE_VID=0x1915
CONFIG_USB_DEVICE_PID=0x9100
CONFIG_USB_DEVICE_INITIALIZE_AT_BOOT=y
CONFIG_UART_INTERRUPT_DRIVEN=y 
CONFIG_USB_DEVICE_PRODUCT="Revolutewrls"
CONFIG_USB_DEVICE_MANUFACTURER="Tongtong.inc"

# CONFIG_USB=y
# CONFIG_USB_DEVICE_STACK=y
# CONFIG_USB_DEVICE_INITIALIZE_AT_BOOT=y
# CONFIG_USB_DEVICE_PRODUCT="Revolute"
# CONFIG_USB_DEVICE_MANUFACTURER="Nordic Semiconductor"
# CONFIG_USB_DEVICE_VID=0x1915
# CONFIG_USB_DEVICE_PID=0x9100
# CONFIG_USB_CDC_ACM=y
```
